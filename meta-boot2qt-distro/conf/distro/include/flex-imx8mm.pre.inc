## meta-boot2qt-distro/conf/distro/include/pico-imx6.conf
```bitbake
############################################################################
##
## Copyright (C) 2018 The Qt Company Ltd.
## Contact: https://www.qt.io/licensing/
##
## This file is part of the Boot to Qt meta layer.
##
## $QT_BEGIN_LICENSE:GPL$
## Commercial License Usage
## Licensees holding valid commercial Qt licenses may use this file in
## accordance with the commercial license agreement provided with the
## Software or, alternatively, in accordance with the terms contained in
## a written agreement between you and The Qt Company. For licensing terms
## and conditions see https://www.qt.io/terms-conditions. For further
## information use the contact form at https://www.qt.io/contact-us.
##
## GNU General Public License Usage
## Alternatively, this file may be used under the terms of the GNU
## General Public License version 3 or (at your option) any later version
## approved by the KDE Free Qt Foundation. The licenses are as published by
## the Free Software Foundation and appearing in the file LICENSE.GPL3
## included in the packaging of this file. Please review the following
## information to ensure the GNU General Public License requirements will
## be met: https://www.gnu.org/licenses/gpl-3.0.html.
##
## $QT_END_LICENSE$
##
############################################################################

DEPLOY_CONF_NAME = "Technexion Pico iMX6"

include conf/distro/include/fsl.inc
include conf/distro/include/fsl-imx-preferred-env.inc

DISTRO_FEATURES_remove = "vulkan"
FSL_EULA_FILE := "${COREBASE}/../meta-fsl-bsp-release/imx/EULA.txt"

BBMASK += "\
    meta-tn-imx-bsp/recipes-extended/connman/ \
    meta-tn-imx-bsp/recipes-connectivity/connman/ \
    meta-tn-imx-bsp/recipes-core/images/ \
    meta-fsl-bsp-release/imx/meta-bsp/recipes-browser/chromium/ \
    meta-fsl-bsp-release/imx/meta-sdk/recipes-fsl/ \
    meta-fsl-bsp-release/imx/meta-sdk/recipes-graphics/devil/ \
    meta-fsl-bsp-release/imx/meta-bsp/recipes-security/optee-imx/optee-os-imx_git.bb \
    meta-fsl-bsp-release/imx/meta-sdk/dynamic-layers/ \
    meta-freescale/dynamic-layers/ \
"
BBMASK_remove = "meta-fsl-bsp-release/imx/meta-bsp/recipes-connectivity/bluez5"

# Boot2Qt specifics
# WIC Image
WIC_FSTAB_BLKDEV = "mmcblk2"
IMAGE_BOOT_FILES += " \
    ${KERNEL_IMAGETYPE} \
    imx6*-pico*.dtb \
    ${IMAGE_BOOTFILES} \
    u-boot-${MACHINE}.${UBOOT_SUFFIX};u-boot.img \
"
# b2qt DEMO app
BOOT2QT_DEMOS_remove = "boot2qt-demo-mediaplayer"

PREFERRED_VERSION_bluez5 = "5.49"
```

## meta-boot2qt-distro/conf/distro/include/pico-imx8mm.conf
```bitbake
############################################################################
##
## Copyright (C) 2018 The Qt Company Ltd.
## Contact: https://www.qt.io/licensing/
##
## This file is part of the Boot to Qt meta layer.
##
## $QT_BEGIN_LICENSE:GPL$
## Commercial License Usage
## Licensees holding valid commercial Qt licenses may use this file in
## accordance with the commercial license agreement provided with the
## Software or, alternatively, in accordance with the terms contained in
## a written agreement between you and The Qt Company. For licensing terms
## and conditions see https://www.qt.io/terms-conditions. For further
## information use the contact form at https://www.qt.io/contact-us.
##
## GNU General Public License Usage
## Alternatively, this file may be used under the terms of the GNU
## General Public License version 3 or (at your option) any later version
## approved by the KDE Free Qt Foundation. The licenses are as published by
## the Free Software Foundation and appearing in the file LICENSE.GPL3
## included in the packaging of this file. Please review the following
## information to ensure the GNU General Public License requirements will
## be met: https://www.gnu.org/licenses/gpl-3.0.html.
##
## $QT_END_LICENSE$
##
############################################################################

DEPLOY_CONF_NAME = "Technexion Pico iMX8MM"

include conf/distro/include/fsl-imx8.inc

BBMASK += "\
    meta-edm-bsp-release/recipes-extended/connman/ \
    meta-edm-bsp-release/recipes-connectivity/connman/ \
    meta-edm-bsp-release/recipes-core/images/ \
    meta-edm-bsp-release/recipes-bsp/imx-atf/imx-atf_1.4.1.bbappend \
    meta-fsl-bsp-release/imx/meta-bsp/recipes-bsp/imx-atf/imx-atf_1.4.1.bb \
    meta-fsl-bsp-release/imx/meta-bsp/recipes-devtools/protobuf/protobuf_3.4.1.bbappend \
    meta-fsl-bsp-release/imx/meta-bsp/recipes-kernel/linux/linux-imx_4.9.11.bbappend \
    meta-fsl-bsp-release/imx/meta-bsp/recipes-security/optee-imx/optee-os-imx_git.bb \
    meta-fsl-bsp-release/imx/meta-sdk/dynamic-layers/ \
"
BBMASK_remove = "meta-fsl-bsp-release/imx/meta-bsp/recipes-connectivity/bluez5"

# Boot2Qt specifics
# WIC Image
IMAGE_BOOT_FILES = "\
    ${KERNEL_IMAGETYPE} \
    imx8mm-pico*.dtb \
    ${IMAGE_BOOTFILES} \
"

# Boot2Qt specifics
BOOT2QT_DEMOS_remove = "boot2qt-demo-mediaplayer"

PREFERRED_VERSION_bluez5 = "5.49"
```

## meta-boot2qt-distro/conf/distro/include/pico-imx8mq.conf
```bitbake
############################################################################
##
## Copyright (C) 2018 The Qt Company Ltd.
## Contact: https://www.qt.io/licensing/
##
## This file is part of the Boot to Qt meta layer.
##
## $QT_BEGIN_LICENSE:GPL$
## Commercial License Usage
## Licensees holding valid commercial Qt licenses may use this file in
## accordance with the commercial license agreement provided with the
## Software or, alternatively, in accordance with the terms contained in
## a written agreement between you and The Qt Company. For licensing terms
## and conditions see https://www.qt.io/terms-conditions. For further
## information use the contact form at https://www.qt.io/contact-us.
##
## GNU General Public License Usage
## Alternatively, this file may be used under the terms of the GNU
## General Public License version 3 or (at your option) any later version
## approved by the KDE Free Qt Foundation. The licenses are as published by
## the Free Software Foundation and appearing in the file LICENSE.GPL3
## included in the packaging of this file. Please review the following
## information to ensure the GNU General Public License requirements will
## be met: https://www.gnu.org/licenses/gpl-3.0.html.
##
## $QT_END_LICENSE$
##
############################################################################

DEPLOY_CONF_NAME = "Technexion Pico iMX8MQ"

include conf/distro/include/fsl.inc

BBMASK += "\
    meta-openembedded/meta-oe/recipes-core/opencl-headers/ \
    meta-imx/meta-bsp/recipes-multimedia/gstreamer/ \
    meta-imx/meta-bsp/recipes-bsp/imx-atf/imx-atf_1.4.1.bb \
    meta-imx/meta-bsp/recipes-security/optee-imx/ \
    meta-imx/meta-sdk/dynamic-layers/qt5-layer/ \
    meta-imx/meta-sdk/recipes-fsl/fsl-rc-local/fsl-rc-local.bbappend \
    meta-imx/meta-sdk/recipes-fsl/images/fsl-image-machine-test.bbappend \
    meta-imx/meta-sdk/recipes-fsl/images/fsl-image-multimedia.bbappend \
    meta-imx/meta-sdk/recipes-fsl/packagegroup/packagegroup-fsl-gstreamer1.0.bbappend \
    meta-imx/meta-sdk/recipes-fsl/packagegroup/packagegroup-fsl-tools-benchmark.bbappend \
    meta-imx/meta-sdk/recipes-fsl/packagegroup/packagegroup-fsl-tools-gpu.bbappend \
    meta-imx/meta-sdk/recipes-fsl/packagegroup/packagegroup-fsl-tools-testapps.bbappend \
    meta-imx/meta-sdk/recipes-graphics/vulkan/vulkan-headers_%.bbappend \
"

BBMASK += "meta-tn-imx-bsp/recipes-connectivity/connman/connman_%.bbappend"
BBMASK += "meta-tn-imx-bsp/recipes-core/images/"
BBMASK += "meta-tn-imx-bsp/recipes-tn/images/"
BBMASK += "meta-tn-imx-bsp/recipes-containers/"
BBMASK += "meta-tn-imx-bsp/recipes-graphics/wayland/weston_%.bbappend"
BBMASK += "meta-tn-imx-bsp/recipes-qt/qt5/qtbase_%.bbappend"
BBMASK += "meta-tn-imx-bsp/recipes-browser/chromium/chromium-ozone-wayland_%.bbappend"
BBMASK += "meta-tn-imx-bsp/recipes-kernel/kernel-modules/kernel-module-nxp-pn5xx_%.bbappend"

# Boot2Qt specifics
DISTRO_FEATURES_remove = "webengine"
BOOT2QT_DEMOS_remove = "boot2qt-demo-mediaplayer"

FSL_EULA_FILE = "${COREBASE}/../meta-imx/EULA.txt"

# Output Specifics
IMAGE_FSTYPES += "wic.xz"
PREFERRED_PROVIDER_virtual/opencl = "imx-gpu-viv"
```
